#include "voltage.h"

extern unsigned int Outburst_Value_Shadow;
extern unsigned int Outburst_Value;

static const float voltage[2000] = {1.2,1.2009,1.2017,1.2026,1.2035,1.2043,1.2052,1.2061,1.2069,1.2078,1.2087,1.2096,1.2104,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5.068,5.0716};
static unsigned int dropDuration = 0, preTimePoint = 0;
static const float op0 = PWMInputVolt*11;
static float op1,op2,op3;
static unsigned int stage = 0;

void V_Init()
{
    /* P2.2: Charge and discharge pin */
    P2SEL0 &= ~BIT2;
    P2SEL1 &= ~BIT2;
    P2OUT &= ~BIT2;
    P2DIR |= BIT2;

    /* P2.5: Comparator input(+) pin */
    P2SEL0 |= BIT5;
    P2SEL1 |= BIT5;
}


void VTask_Activate(void)
{
    switch(stage)
    {
    case 0:
    {
        V_stopFlag = 0;
        stage = 1;

        /* TB1£ºCharging time setting */
        TB1CCR1 = ChargingDuration-1;
        TB1CCTL1 = CAP__COMPARE|CCIE;
        TB1CTL = TBCLR|TBSSEL__ACLK|MC__CONTINUOUS;

        /* Charge the capacitor */
        P2OUT |= BIT2;
    }break;
    case 1:
    {
        stage = 0;

        /* Comparator setup */
        CP1CTL0 = CPNEN_1|CPNSEL_2|CPPEN_1|CPPSEL_0;
        CP1CTL1 = CPMSEL_1|CPEN|CPIIE_1;

        /* Set the reference voltage to the comparator input(-) */
        PMMCTL2 = INTREFEN_1;

        /* TB1£ºCharging time setting */
        TB1CCTL1 = 0;
        TB1CTL = TBCLR|TBSSEL__ACLK|MC__CONTINUOUS;

        /* Discharge */
        _DINT();
        P2OUT &= ~BIT2;
        preTimePoint = TB1R;
        _EINT();
    }
    }

    TskExit();
}

void VTask_Probe(void)
{
    /* Close the comparator and timer */
    CP1CTL0 = 0;
    CP1CTL1 = 0;
    TB1CTL = 0;
    TB1CCTL0 = 0;
    TB1CCR0 = 0;
    PMMCTL2 = 0;

    /* Supply voltage */
    dropDuration = dropDuration-preTimePoint;
    if(dropDuration<2000)
        V_vp = voltage[dropDuration];

    if(Setup_senseCount>0)
    {
        TskSetReady(VTASK_ACTIVATE);

        /* Calibration */
        op1 = op0*Outburst_Value_Shadow;
        op2 = V_vp*8;
        op3 = op1/op2;
        Outburst_Value = op3+0.4;

        if((V_vp > 1.8)
           && (SS_exceptionFlag == 1 || SS_stopFlag == 1))
            TskSetReady(SSTASK_ACTIVATE);
    }
    else
        V_stopFlag = 1;


    TskExit();
}


#pragma vector = TIMER1_B1_VECTOR
__interrupt void TIMER1_B1_ISR(void)
{
    switch(__even_in_range(TB1IV, TBIV_14))
    {
    case TBIV__TBCCR1:
    {
        TskSetReady(VTASK_ACTIVATE);
        __low_power_mode_off_on_exit();
    }
    }
}


#pragma vector = ECOMP0_ECOMP1_VECTOR
__interrupt void ECOMP0_ECOMP1_ISR(void)
{
    dropDuration = TB1R;
    switch (__even_in_range(CP1IV,4))
    {
    case CPIV__CPIIFG:
    {
        TskSetReady(VTASK_PROBE);
        __low_power_mode_off_on_exit();
    }
    }
}
